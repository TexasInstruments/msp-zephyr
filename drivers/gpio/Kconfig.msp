## drivers/gpio/Kconfig.msp
```kconfig
# TI MSP GPIO configuration options

# Copyright (c) 2025 Texas Instruments
# SPDX-License-Identifier: Apache-2.0

config GPIO_MSP
	bool "TI MSP GPIO driver"
	default y
	depends on DT_HAS_TI_MSP_GPIO_ENABLED
	select USE_MSP_DL_GPIO
	help
	  Enable the TI MSP GPIO driver for MSPM0 and MSPM33 series.
```

## drivers/pinctrl/Kconfig.msp
```kconfig
# SPDX-License-Identifier: Apache-2.0
# Copyright (c) 2025 Texas Instruments

config PINCTRL_MSP
	bool "TI pinctrl MSP driver"
	default y
	depends on DT_HAS_TI_MSP_PINCTRL_ENABLED
	help
	  Enable support for the PINCTRL on TI MSPM0 and MSPM33 series.
```

## drivers/serial/Kconfig.msp
```kconfig
# SPDX-License-Identifier: Apache-2.0
# Copyright (c) 2025 Texas Instruments
# Copyright (c) 2025 Linumiz

config UART_MSP
	bool "MSP UART driver"
	default y
	depends on DT_HAS_TI_MSPM0_UART_ENABLED
	select SERIAL_HAS_DRIVER
	select SERIAL_SUPPORT_INTERRUPT
	select USE_MSP_DL_UNICOMM_UART if (HAS_MSP_UNICOMM)
	select USE_MSP_DL_UART if !(HAS_MSP_UNICOMM)
	select PINCTRL
	help
	  This option enables the TI MSP family UART driver.
```

## drivers/spi/Kconfig.mspm0
```kconfig
# Copyright (C) 2024 Bang & Olufsen A/S, Denmark
# SPDX-License-Identifier: Apache-2.0

config SPI_MSPM0
	bool "MSPM0 SPI driver"
	default y
	depends on DT_HAS_TI_MSPM0_SPI_ENABLED
	help
	  Enable driver for TI MSPM0 SPI.
```

## dts/bindings/serial/ti,msp-uart.yaml
```yaml
description: TI MSP Family UART

compatible: "ti,msp-uart"

include: [uart-controller.yaml, pinctrl-device.yaml, base.yaml]

properties:
  reg:
    required: true

  interrupts:
    required: true

  pinctrl-0:
    required: true

  pinctrl-names:
    required: true

  clk-div:
    type: int
    default: 1
    enum:
      - 1
      - 2
      - 3
      - 4
      - 5
      - 6
      - 7
      - 8
    description: |
      Clock divider selection value.

  oversampling-rate:
    type: int
    default: 16
    enum:
      - 16
      - 8
      - 3
    description: |
      UART oversampling rate. Valid values are 16 (16x), 8 (8x), or 3 (3x).
      Default is 16 (16x oversampling).
```
