## dts/bindings/pinctrl/ti,msp-pinctrl.yaml
```yaml
# Copyright (c) 2025 Texas Instruments
# Copyright (c) 2025 Linumiz
# SPDX-License-Identifier: Apache-2.0

description: |
    TI MSP pinctrl node.

    This binding is compatible with both MSPM0 and MSPM33 series microcontrollers.

    Device pin configuration should be placed in the child nodes of this node.
    Populate the 'pinmux' field with a pair consisting of a pin number and its
    IO functions.

    The node has the 'pinctrl' node label set in your SoC's devicetree,
    so you can modify it like this:

      &pinctrl {
              /* your modifications go here */
      };

    All device pin configurations should be placed in child nodes of the
    'pinctrl' node, as in the i2c0 example shown at the end.

    Here is a list of
    supported standard pin properties:

    - bias-disable: Disable pull-up/down.
    - bias-pull-down: Enable pull-down resistor.
    - bias-pull-up: Enable pull-up resistor.
    - drive-open-drain: Output driver is open-drain.
    - drive-open-drain: Output driver is open-source.
    - ti,high-drive: Enable high-drive mode for increased current (HDIO pins only).
    - input-enable: enable input.
    - ti,invert: enable logical inversion of a digital input or output
    - ti,hysteresis: enable hysteresis control on open-drain pins

    An example for MSP family, include the chip level pinctrl
    DTSI file in the board level DTS:

      #include <dt-bindings/pinctrl/msp-pinctrl.h>

    We want to configure the I2C pins to open drain, with pullup enabled
    and input enabled.

    To change a pin's pinctrl default properties add a reference to the
    pin in the board's DTS file or in the project overlay and set the
    properties.

      &i2c1 {
        pinctrl-0 = <&i2c1_scl_pb2_pull_up &i2c1_sda_pb3_pull_up>;
        pinctrl-names = "default";
      }

    The i2c1_scl_pb2_pull_up corresponds to the following pin configuration in
    the board dts file:

      &pinctrl {
        i2c1_scl_pb2_pull_up: i2c1_scl_pb2_pull_up {
          pinmux = <MSP_PINMUX(15,MSP_PIN_FUNCTION_4)>;
          input-enable;
          bias-pull-up;
          drive-open-drain;
        };
      };

    Pin pb2 refers to the device pin name that one would see printed on the
    launchpad, and the number 15 in the pinmux define refers to the PINCMx.

    These are obtained from the device-specific datasheet.

compatible: "ti,msp-pinctrl"

include: base.yaml

properties:
  reg:
    required: true

child-binding:
  description: |
    This binding gives a base representation of the MSP
    pins configuration.

  include:
    - name: pincfg-node.yaml
      property-allowlist:
        - bias-disable
        - bias-pull-down
        - bias-pull-up
        - bias-high-impedance
        - drive-open-drain
        - drive-open-source
        - input-enable

  properties:
    pinmux:
      required: true
      type: int
      description: |
        MSP pin's configuration (IO pin, IO function).

    ti,high-drive:
      type: boolean
      description: |
        Enable high-drive strength mode (HDIO) on capable pins.
        When enabled, increases maximum drive current to approximately 20mA.
        When disabled (default), pin uses standard drive strength of
        approximately 6mA.

        IMPORTANT: Not all pins support high-drive mode. Consult the device
        datasheet IOMUX table to verify pin capabilities before enabling this
        feature. Enabling high-drive on non-HDIO capable pins has no effect.

    ti,invert:
      type: boolean
      description: |
        Enables inversion of the input or output using the internal
        inversion capability of the GPIO

    ti,hysteresis:
      type: boolean
      description: |
        Enables the hysteresis control for access to CMOS logic
        (on open-drain capable pins)
```

## dts/bindings/spi/ti,msp-spi.yaml
```yaml
# Copyright (c) 2025 Linumiz GmbH
# Copyright (c) 2025 Texas Instruments
# SPDX-License-Identifier: Apache-2.0

description: |
   Texas Instruments MSP SERIAL PERIPHERAL INTERFACE (SPI).

compatible: "ti,msp-spi"

include: [spi-controller.yaml, pinctrl-device.yaml]

properties:
  reg:
    required: true

  interrupts:
    required: true

  pinctrl-0:
    required: true

  pinctrl-names:
    required: true

  ti,clk-div:
    type: int
    default: 1
    enum:
      - 1
      - 2
      - 3
      - 4
      - 5
      - 6
      - 7
      - 8

  hw-chip-select:
    type: string
    default: "DL_SPI_CHIP_SELECT_NONE"
    enum:
      - "DL_SPI_CHIP_SELECT_NONE"
      - "DL_SPI_CHIP_SELECT_0"
      - "DL_SPI_CHIP_SELECT_1"
      - "DL_SPI_CHIP_SELECT_2"
      - "DL_SPI_CHIP_SELECT_3"
    description: |
      Use dedicated hardware chip select pin. The selected signal is controlled
      automatically during transfer.
```

## dts/bindings/timer/ti,msp-timer.yaml
```yaml
# Copyright 2025 Linumiz GmbH
# SPDX-License-Identifier: Apache-2.0

description: TI MSP Timer

compatible: "ti,msp-timer"

include: base.yaml

properties:
  reg:
    required: true

  interrupts:
    required: true

  clocks:
    required: true
    description: |
      Clock source for the timer. Timer instances in different power domains
      require specific clock sources:
      - PD0 timers: Use LFCLK (low-frequency clock)
      - PD1 TIMG timers: Use MCLKBY2 (derived from main clock)
      - PD1 TIMA timers: Use MCLK (main clock)

      Ensure the clock source matches the timer's power domain to avoid runtime
      failures or incorrect timer operation.

  ti,clk-prescaler:
    type: int
    description: |
      TIMCLK clock source prescaler value.
      Valid range [0 ... 255].

      NOTE: Not supported on 32-bit timers without prescaler hardware.
      Omit this property for timers without prescaler support.

  ti,clk-div:
    type: int
    required: true
    default: 1
    enum:
      - 1
      - 2
      - 3
      - 4
      - 5
      - 6
      - 7
      - 8
    description: |
      Clock divider selction value.
```

## dts/bindings/usb/ti,mspm0-usb.yaml
```yaml
# Copyright (c) 2023 Nordic Semiconductor ASA
# SPDX-License-Identifier: Apache-2.0

description: Skeleton for USB device controller driver

compatible: "ti,mspm0-usb"

include: usb-ep.yaml
```

## modules/Kconfig.mspm0
```kconfig
# MSPM0 SDK configuration

# Copyright (c) 2025 Texas Instruments
# SPDX-License-Identifier: Apache-2.0

config HAS_MSPM0_SDK
	bool

config USE_MSPM0_DL_GPIO
	bool

config USE_MSPM0_DL_UART
	bool

config USE_MSPM0_DL_UNICOMM_UART
	bool

config USE_MSPM0_DL_TIMER
	bool

config USE_MSPM0_DL_MCAN
	bool

config USE_MSPM0_DL_FLASHCTL
	bool

config USE_MSPM0_DL_I2C
	bool

config USE_MSPM0_DL_UNICOMM_I2CC
	bool

config USE_MSPM0_DL_UNICOMM_I2CT
	bool

config USE_MSPM0_DL_ADC
	bool 
	
config USE_MSPM0_DL_VREF
	bool
```

## modules/Kconfig.mspm33
```kconfig
config HAS_MSPM33_SDK
	bool

config USE_MSP_DL_GPIO
	bool

config USE_MSP_DL_UNICOMM_UART
	bool

config USE_MSP_DL_TIMER
	bool

config USE_MSP_DL_VREF
	bool

config USE_MSP_DL_HSADC
	bool

config USE_MSP_DL_UNICOMM_SPI
	bool

config USE_MSP_DL_DMA
	bool

config USE_MSP_DL_UNICOMM_I2CC
	bool

config USE_MSP_DL_UNICOMM_I2CT
	bool

config USE_MSP_DL_RTC_COMMON
	bool

config USE_MSP_DL_MCAN
	bool
```

## samples/basic/msp_thread_example/sample.yaml
```yaml
sample:
  name: MSP Thread Example
  description: MSP thread example application
tests:
  sample.basic.msp_thread_example:
    tags: msp
    platform_allow: lp_mspm33c321a
```

## samples/subsys/fs/littlefs/boards/lp_mspm0g3519.conf
```kconfig
# Copyright 2026 Texas Instruments Inc
# SPDX-License-Identifier: Apache-2.0

CONFIG_FS_LITTLEFS_CACHE_SIZE=128
```

## soc/ti/mspm33/Kconfig
```kconfig
# Texas Instruments MSPM33 Family
# Copyright (c) 2025 Texas Instruments
# Copyright (c) 2025 Linumiz
# SPDX-License-Identifier: Apache-2.0

if SOC_FAMILY_TI_MSPM33

rsource "*/Kconfig"

config MSP_PERIPH_STARTUP_DELAY
	int
	default 8

endif # SOC_FAMILY_TI_MSPM33
```

## soc/ti/mspm33/Kconfig.defconfig
```kconfig
# SPDX-License-Identifier: Apache-2.0
# Copyright (c) 2025 Texas Instruments

if SOC_FAMILY_TI_MSPM33

rsource "*/Kconfig.defconfig"

DT_CHOSEN_Z_FLASH := zephyr,flash

config FLASH_SIZE
	default $(dt_chosen_reg_size_int,$(DT_CHOSEN_Z_FLASH),0,K)

config FLASH_BASE_ADDRESS
	default $(dt_chosen_reg_addr_hex,$(DT_CHOSEN_Z_FLASH))

config SYS_CLOCK_HW_CYCLES_PER_SEC
	default 160000000

endif # SOC_FAMILY_TI_MSPM33
```

## soc/ti/mspm33/Kconfig.soc
```kconfig
# Texas Instruments MSPM33 Family

# Copyright (c) 2025 Texas Instruments
# SPDX-License-Identifier: Apache-2.0

config SOC_FAMILY_TI_MSPM33
	bool

config SOC_FAMILY
	default "ti_mspm33" if SOC_FAMILY_TI_MSPM33

config HAS_MSP_UNICOMM
	bool

rsource "*/Kconfig.soc"
```

## soc/ti/mspm33/mspm33c/Kconfig
```kconfig
# TI MSPM33C

# Copyright (c) 2025 Texas Instruments
# Copyright (c) 2025 Linumiz
# SPDX-License-Identifier: Apache-2.0

config SOC_MSPM33C321A
	select ARM
	select CPU_CORTEX_M33
	select CPU_CORTEX_M_HAS_VTOR
	select CPU_HAS_ARM_MPU
	select CPU_HAS_FPU
	select ARMV8_M_DSP
	select BUILD_OUTPUT_BIN
	select BUILD_OUTPUT_HEX
	select HAS_MSPM33_SDK
	select CPU_CORTEX_M_HAS_SYSTICK
```

## soc/ti/mspm33/mspm33c/Kconfig.defconfig
```kconfig
# TI MSPM33C series

# Copyright (c) 2025 Texas Instruments
# SPDX-License-Identifier: Apache-2.0

#flash thing to be added

if SOC_SERIES_MSPM33C

config NUM_IRQS
	default 58

endif # SOC_SERIES_MSPM33C
```

## soc/ti/mspm33/mspm33c/Kconfig.soc
```kconfig
# Copyright (c) 2025 Texas Instruments
# SPDX-License-Identifier: Apache-2.0

config SOC_SERIES_MSPM33C
  	bool
	select SOC_FAMILY_TI_MSPM33
	help
	  Enable support for TI MSPM33C series SoCs

config SOC_MSPM33C321A
	bool
	select SOC_SERIES_MSPM33C

config SOC_SERIES
	default "mspm33c" if SOC_SERIES_MSPM33C

config SOC
	default "mspm33c321a" if SOC_MSPM33C321A
```

## tests/drivers/i2c/i2c_codec/testcase.yaml
```yaml
common:
  tags:
    - i2c
    - drivers
  depends_on: i2c

tests:
  drivers.i2c.codec:
    platform_allow:
      - lp_mspm33c321a
```

## ti_tests/drivers/bq27z8xx/df_write/testcase.yaml
```yaml
tests:
  drivers.fuel_gauge.bq27z8xx.df_write:
    tags:
      - drivers
      - fuel_gauge
    filter: dt_compat_enabled("ti,bq27z855")
    platform_allow:
      - native_sim
      - lp_mspm0g3507
```
