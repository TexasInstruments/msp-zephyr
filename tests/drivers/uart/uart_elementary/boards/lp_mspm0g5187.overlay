/*
 * Copyright (c) 2026 Texas Instruments Incorporated
 *
 * SPDX-License-Identifier: Apache-2.0
 */

&unicomm1 {
	status = "okay";
};

dut: &unicomm1_uart {
	pinctrl-0 = <&uc1_tx_pa16 &uc1_rx_pb22 &uc1_cts_pb23 &uc1_rts_pa30>;
	pinctrl-names = "default";
	current-speed = <115200>;
	hw-flow-control;
	status = "okay";
};
