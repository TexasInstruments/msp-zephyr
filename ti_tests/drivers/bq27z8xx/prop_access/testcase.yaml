## ti_tests/drivers/bq27z8xx/prop_access/testcase.yaml
```yaml
tests:
  drivers.fuel_gauge.bq27z8xx.prop_access:
    tags:
      - drivers
      - fuel_gauge
    filter: dt_compat_enabled("ti,bq27z855")
    platform_allow:
      - native_sim
      - lp_mspm0g3507
```

## ti_tests/drivers/i2c/i2c_controller/testcase.yaml
```yaml
tests:
  drivers.i2c.mspm0.loopback.controller.100k:
    tags:
      - i2c
      - mspm0
      - loopback
    platform_allow:
      - lp_mspm0g3507
      - lp_mspm0l2228
    harness: ztest
    integration_platforms:
      - lp_mspm0g3507
      - lp_mspm0l2228

  drivers.i2c.mspm0.loopback.controller.400k:
    tags:
      - i2c
      - mspm0
      - loopback
    platform_allow:
      - lp_mspm0g3507
      - lp_mspm0l2228
    harness: ztest
    integration_platforms:
      - lp_mspm0g3507
      - lp_mspm0l2228
    extra_args: EXTRA_DTC_OVERLAY_FILE=boards/freq_400k.overlay

  drivers.i2c.mspm0.loopback.controller.1mhz:
    tags:
      - i2c
      - mspm0
      - loopback
    platform_allow:
      - lp_mspm0g3507
      - lp_mspm0l2228
    harness: ztest
    integration_platforms:
      - lp_mspm0g3507
      - lp_mspm0l2228
    extra_args: EXTRA_DTC_OVERLAY_FILE=boards/freq_1mhz.overlay
```

## ti_tests/drivers/i2c/i2c_controller_old/testcase.yaml
```yaml
tests:
  ti.drivers.i2c.controller:
    depends_on: i2c
    tags:
      - drivers
      - i2c
      - ti
    platform_allow:
      - lp_mspm0g3507
      - lp_mspm0g3519
      - lp_mspm0l1117
      - lp_mspm0l2228
    harness: ztest
```

## ti_tests/drivers/i2c/i2c_target_old/testcase.yaml
```yaml
tests:
  drivers.i2c.mspm0.target:
    tags:
      - i2c
      - mspm0
      - target
    platform_allow:
      - lp_mspm0g3507
    harness: ztest
    integration_platforms:
      - lp_mspm0g3507
```
