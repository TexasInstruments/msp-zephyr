/ {
	aliases {
		i2c-0 = &i2c0;
		dev-1 = &dev1;
	};
};

&i2c0 {
	pinctrl-0 = <&i2c0_scl_pa1 &i2c0_sda_pa0>;
	pinctrl-names = "default";
	clock-frequency = <400000>;
	status = "okay";
	dev1: dev1@32 {
		compatible = "i2c-device";
		reg = <0x32>;
		label = "DEV1";
	};
};
