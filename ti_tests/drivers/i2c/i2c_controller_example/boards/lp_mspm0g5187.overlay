/*
 * I2C Loopback Test - Controller Board Overlay (LP-MSPM0G5187)
 *
 * I2C:     SDA = PA0, SCL = PA1  (unicomm1_i2cc)
 */

/ {
	aliases {
		i2c-0 = &unicomm1_i2cc;
		dev-1 = &dev1;
	};
};

&unicomm1_i2cc {
	status = "okay";
	pinctrl-0 = <&uc1_scl_pa1 &uc1_sda_pa0>;
	pinctrl-names = "default";
	clock-frequency = <400000>;
	dev1: dev1@32 {
		compatible = "i2c-device";
		reg = <0x32>;
		label = "DEV1";
	};
};
