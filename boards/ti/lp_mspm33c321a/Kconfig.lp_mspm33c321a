## boards/ti/lp_mspm33c321a/Kconfig.lp_mspm33c321a
```kconfig
# Copyright (c) 2025 Texas Instruments
# SPDX-License-Identifier: Apache-2.0

config BOARD_LP_MSPM33C321A
	select SOC_MSPM33C321A
	select HAS_COVERAGE_SUPPORT
```

## drivers/adc/Kconfig.mspm33
```kconfig
# SPDX-License-Identifier: Apache-2.0
# Copyright (c) 2025 Texas Instruments

config ADC_MSP_HSADC
	bool "TI ADC MSPM33 driver"
	default y
	depends on DT_HAS_TI_MSP_HSADC_ENABLED
	select USE_MSP_DL_HSADC
	select USE_MSP_DL_VREF
	help
	  Enable support for HSADC on the TI MSPM33 series.

config ADC_MSP_HSADC_SOC_MAX
	int "Maximum number of Start of Conversion (SOC) entries"
	depends on ADC_MSP_HSADC
	default 16
	range 1 16
	help
	  Maximum number of SOCs supported by the HSADC hardware.
	  The MSPM33 HSADC supports up to 16 SOCs for sequence conversion.

config ADC_MSP_HSADC_CHANNEL_MAX
	int "Maximum number of ADC input channels"
	depends on ADC_MSP_HSADC
	default 32
	range 1 32
	help
	  Maximum number of ADC input channels supported by the HSADC hardware.
	  The MSPM33 HSADC supports up to 32 input channels.

config ADC_MSP_HSADC_DMA
	bool "DMA support for TI MSPM33 HSADC"
	depends on ADC_MSP_HSADC
	select DMA
	help
	  DMA driven mode offloads ADC result transfer from the CPU.
	  Requires dmas property in the ADC device tree node.
```

## drivers/can/Kconfig.msp
```kconfig
# Copyright (c) 2026 Texas Instruments
# SPDX-License-Identifier: Apache-2.0

config CAN_MSP_CANFD
	bool "MSP CANFD driver"
	default y
	depends on DT_HAS_TI_MSP_CANFD_ENABLED
	select CAN_MCAN
	select USE_MSP_DL_MCAN
	select PINCTRL
	help
	  Enable support for CANFD on the TI MSP series.
```

## drivers/charger/Kconfig.bq25628
```kconfig
# Copyright 2025 Texas Instruments
#
# SPDX-License-Identifier: Apache-2.0

config CHARGER_BQ25628
	bool "BQ25628 Battery Charger"
	default y
	depends on DT_HAS_TI_BQ25628_ENABLED
	select I2C
	help
	  Enable BQ25628 battery charger driver.
```

## drivers/clock_control/Kconfig.msp
```kconfig
# Copyright (c) 2025 Texas Instruments
# SPDX-License-Identifier: Apache-2.0

config CLOCK_CONTROL_MSP
	bool "MSP Clock Control"
	default y
	depends on SOC_FAMILY_TI_MSPM0 || SOC_FAMILY_TI_MSPM33
	help
	  Enable driver for MSP Clock Control.
	  This driver supports both MSPM0 and MSPM33 series.
```

## drivers/comparator/Kconfig.mspm0
```kconfig
# Copyright (c) 2026 Texas Instruments Inc. 
# SPDX-License-Identifier: Apache 2.0

config COMPARATOR_MSPM0_COMP
	bool "MSPM0 COMP comparator driver"
	default y
	depends on DT_HAS_TI_MSPM0_COMP_ENABLED
	select PINCTRL
	help
	  This option enables the TI MSPM0 Comparator driver.
```

## drivers/counter/Kconfig.msp
```kconfig
# Copyright (c) 2025 Linumiz GmbH
# SPDX-License-Identifier: Apache-2.0

config COUNTER_MSP_TIMER
	bool "TI MSP MCU family counter driver"
	default y
	depends on DT_HAS_TI_MSP_TIMER_COUNTER_ENABLED
	select USE_MSP_DL_TIMER
	help
	  Enable the TI MSP MCU family counter driver.
```

## drivers/dma/Kconfig.ti_msp
```kconfig
# Copyright (c) 2025 Texas Instruments.
#
# SPDX-License-Identifier: Apache-2.0

config DMA_TI_MSP
	bool "Texas Instruments MSP DMA Controller Driver"
	default y
	depends on DT_HAS_TI_MSP_DMA_ENABLED
	select USE_MSP_DL_DMA
	help
	  Enable Texas Instruments MSP Family DMA driver.
```

## drivers/entropy/Kconfig.msp_trng
```kconfig
# Copyright (c) 2025, Linumiz GmbH
# SPDX-License-Identifier: Apache-2.0

config ENTROPY_MSP_TRNG
	bool "TI MSP True Random Number Generator (TRNG)"
	default y
	depends on DT_HAS_TI_MSP_TRNG_ENABLED
	select ENTROPY_HAS_DRIVER
	select USE_MSP_DL_TRNG
	select RING_BUFFER
	help
	  This option enables the driver for the True Random Number Generator (TRNG)
	  for TI MSP SoCs.

if ENTROPY_MSP_TRNG

config ENTROPY_MSP_TRNG_POOL_SIZE
	int "Entropy pool buffer size in bytes"
	default 256
	help
	  The size in bytes of the ring buffer used to store entropy generated by the
	  TRNG hardware.

config ENTROPY_MSP_TRNG_DECIMATION_RATE
	int "TRNG decimation rate (0-7)"
	default 4
	range 0 7
	help
	  The decimation rate controls the sampling rate of the TRNG. Higher values
	  provide better entropy quality. A decimation rate of 4 or greater is recommended per TRM.
	  Valid values are 0-7.
endif # ENTROPY_MSP_TRNG
```

## drivers/i2c/Kconfig.mspm0
```kconfig
# SPDX-License-Identifier: Apache-2.0
# Copyright (c) 2024 Texas Instruments

config I2C_MSPM0
	bool "MSPM0 I2C driver"
	default y
	depends on DT_HAS_TI_MSPM0_I2C_ENABLED
	select USE_MSPM0_DL_UNICOMM_I2CC if (HAS_MSP_UNICOMM && !CONFIG_I2C_TARGET)
	select USE_MSPM0_DL_UNICOMM_I2CT if (HAS_MSP_UNICOMM && CONFIG_I2C_TARGET)
	select USE_MSPM0_DL_I2C if !(HAS_MSP_UNICOMM)
	select PINCTRL
	help
	  This option enables the TI MSPM0 I2C driver.

config I2C_SCL_LOW_TIMEOUT_MS
	int "I2C SCL Timeout"
	default 1000
	help
	  Hardware Timeout in milliseconds that reflects the acceptable
	  cumulative low period in a transaction. Note this
	  can be a restriction on very long SCL stretch

config I2C_TRANSFER_TIMEOUT_MS
	int "I2C Transfer Timeout"
	default 2000
	help
	  Software Timeout in milliseconds to wait for an I2C
	  transfer to complete before timing out.
```

## drivers/led/Kconfig.lp5810_lp5811
```kconfig
# Copyright (c) 2025 Texas Instruments
# SPDX-License-Identifier: Apache-2.0

config LP5810_LP5811
	bool "LP5810/LP5811 LED driver"
	default y
	depends on (DT_HAS_TI_LP5810_ENABLED || DT_HAS_TI_LP5811_ENABLED)
	select I2C
	help
	  Enable LED driver for LP5810/LP5811. LP5810/LP5811 LED driver has 4 channels.
```

## drivers/rtc/Kconfig.ti_msp
```kconfig
# Copyright (c) 2025 Linumiz GmbH
# SPDX-License-Identifier: Apache-2.0

config RTC_TI_MSP
	bool "Texas Instruments MSP RTC driver"
	default y
	depends on DT_HAS_TI_MSP_RTC_ENABLED
	select USE_MSP_DL_RTC_COMMON
	help
	  Texas Instruments Real-Time Clock (RTC) driver for MSP SoC families.
```

## drivers/spi/Kconfig.msp
```kconfig
# Copyright (c) 2025 Linumiz GmbH
# SPDX-License-Identifier: Apache-2.0

config SPI_MSP
	bool "TI's MSP SPI"
	default y
	depends on DT_HAS_TI_MSPM0_SPI_ENABLED
	select USE_MSP_DL_UNICOMM_SPI if (HAS_MSP_UNICOMM)
	select USE_MSP_DL_SPI if !(HAS_MSP_UNICOMM)
	select PINCTRL
	help
	 This driver enable TI MSP spi driver.
```

## drivers/usb/udc/Kconfig.mspm0
```kconfig
# Copyright (c) 2024 Texas Instruments Incorporated
# SPDX-License-Identifier: Apache-2.0

config UDC_MSPM0
	bool "MSPM0 USB Device Controller"
	default y
	depends on DT_HAS_TI_MSPM0_USB_ENABLED
	select EVENTS
	help
	  MSPM0 USB device controller driver

config UDC_MSPM0_STACK_SIZE
	int "MSPM0 UDC stack size"
	default 512
	help
	  MSPM0 USB device controller thread stack size
```

## dts/bindings/adc/ti,msp-hsadc.yaml
```yaml
description: TI MSP HSADC

compatible: "ti,msp-hsadc"

include: [adc-controller.yaml]

properties:
  reg:
    required: true
    description: |
      Register space for the ADC. Should contain two entries:
      - First entry for configuration registers (ADC_LITE_REGS)
      - Second entry for result registers (ADC_LITE_RESULT_REGS)

  reg-names:
    required: true
    description: |
      Names for the register spaces. Must include:
      - "config" for the configuration registers
      - "result" for the result registers

  interrupts:
    required: true

  "#io-channel-cells":
    const: 1

  ti,clk-divider:
    type: int
    required: true
    enum:
      - 0  # ADCCLK = (internal clock) / 1.0
      - 1  # ADCCLK = (internal clock) / 1.5
      - 2  # ADCCLK = (internal clock) / 2.0
      - 3  # ADCCLK = (internal clock) / 2.5
      - 4  # ADCCLK = (internal clock) / 3.0
      - 5  # ADCCLK = (internal clock) / 3.5
      - 6  # ADCCLK = (internal clock) / 4.0
      - 7  # ADCCLK = (internal clock) / 4.5
      - 8  # ADCCLK = (internal clock) / 5.0
      - 9  # ADCCLK = (internal clock) / 5.5
      - 10 # ADCCLK = (internal clock) / 6.0
      - 11 # ADCCLK = (internal clock) / 6.5
      - 12 # ADCCLK = (internal clock) / 7.0
      - 13 # ADCCLK = (internal clock) / 7.5
      - 14 # ADCCLK = (internal clock) / 8.0
      - 15 # ADCCLK = (internal clock) / 8.5
    description: |
      ADC clock divider:
      Applies to the internal ADC clock.

  vref-mv:
    type: int
    default: 3300
    description: |
      Reference voltage in millivolts. This property controls both the hardware
      VREF source and the value used for raw-to-voltage conversion:

        - 2500: Enables internal 2.5V reference (VREF peripheral)
        - 1400: Enables internal 1.4V reference (VREF peripheral)
        - Any other value: Uses VDDA as reference (set to board VDD voltage)

      This property is used by adc_ref_internal() API and raw-to-millivolts
      conversion functions.

io-channel-cells:
  - input
```

## dts/bindings/can/ti,msp-canfd.yaml
```yaml
# Copyright (c) 2026 Texas Instruments
# SPDX-License-Identifier: Apache-2.0

description: TI MSP CANFD

compatible: "ti,msp-canfd"

include: ["bosch,m_can-base.yaml", "pinctrl-device.yaml"]

properties:
  reg:
    required: true

  interrupts:
    required: true

  clocks:
    required: true

  clock-frequency:
    required: true
    type: int
    description: |
      Desired MCAN functional clock frequency (MCAN_FCLK) in Hz.
```

## dts/bindings/clock/ti,msp-clk.yaml
```yaml
# Copyright (c) 2025 Texas Instruments Inc.
# Copyright (c) 2025 Linumiz
# SPDX-License-Identifier: Apache-2.0

description: TI MSP Clock

compatible: "ti,msp-clk"

include: [clock-controller.yaml, base.yaml]

properties:
  "#clock-cells":
    const: 1

  clock-frequency:
    type: int
    description: |
      Output clock frequency in Hz.

  clk-div:
    type: int
    description: |
      Clock divider selection value. Valid range [2, 4, 6, 8, 10, 12, 14, 16]

clock-cells:
  - clk
```

## dts/bindings/clock/ti,msp-osc.yaml
```yaml
# Copyright (c) 2025 Texas Instruments Inc.
# Copyright (c) 2025 Linumiz
# SPDX-License-Identifier: Apache-2.0

description: TI MSP oscillator

compatible: "ti,msp-osc"

include: [fixed-clock.yaml, base.yaml]

properties:
  "#clock-cells":
    const: 0

  ti,xtal-startup-delay-us:
    type: int
    description: |
      Crystal Oscillator startup delay in micro seconds.

  ti,low-cap:
    type: boolean
    description: |
      Specifies if capacitance is less than 3pF to reduce power consumption.

  ti,drive-strength:
    type: int
    description: |
      Drive strength setting for the oscillator. Valid range [0 ... 3].
      Higher value means higher drive strength.

  ti,monitor-enable:
    type: int
    description: |
      Enable clock monitoring circuit to detect clock failures.
```

## dts/bindings/clock/ti,msp-pll.yaml
```yaml
# Copyright (c) 2025 Texas Instruments Inc.
# SPDX-License-Identifier: Apache-2.0

description: TI MSP Phase Locked Loop

compatible: "ti,msp-pll"

include: [clock-controller.yaml, base.yaml]

properties:
  clocks:
    required: true

  "#clock-cells":
    const: 0

  p-div:
    type: int
    required: true
    enum:
      - 1
      - 2
      - 4
      - 8
    description: |
      pdiv is the pre-divider of the output. ref_in / pdiv * qdiv = VCO

  q-div:
    type: int
    required: true
    description: |
      qdiv functions as a multiplier value for the ref_in / pdiv * qdiv = VCO
      Valid Range: 2 - 128

  clk0-div:
    type: int
    description: |
      CLK0 PLL output is only enabled if the divider is present. Use CLK0 on
      the MSP to output to the MCLK, UCLK, and CPUCLK
      Valid Range: 1 - 16

  clk1-div:
    type: int
    description: |
      CLK1 PLL output is only enabled if the divider is present. Use CLK1 on
      the MSP to output to the CANCLK, FCC, or output via EXCLK
      Valid Range: 1 - 16

  clk2x-div:
    type: int
    description: |
      CLK2X PLL output is only enabled if the divider is present. Use CLK2X on
      the MSP to output to the MCLK, UCLK, and CPUCLK instead of CLK0
      Valid Range: 1 - 16

  pll-clk-div:
    type: int
    description: |
      Clock divider selection value for the PLL output. Valid range [2,4,6,8,10,12,14,16].
```
