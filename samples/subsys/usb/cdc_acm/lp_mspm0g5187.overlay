/*
 * Copyright (c) 2021 Nordic Semiconductor ASA
 *
 * SPDX-License-Identifier: Apache-2.0
 */

&usbfs0 {
	status = "okay";
	maximum-speed = "full-speed";
	cdc_acm_uart0 {
		compatible = "zephyr,cdc-acm-uart";
	};
};
